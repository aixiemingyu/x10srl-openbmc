## meta-supermicro-x10srl/conf/layer.conf
```bitbake
# Layer configuration
BBPATH .= ":${LAYERDIR}"

BBFILES += "${LAYERDIR}/recipes-*/*/*.bb ${LAYERDIR}/recipes-*/*/*.bbappend"

BBFILE_COLLECTIONS += "meta-supermicro-x10srl"
BBFILE_PATTERN_meta-supermicro-x10srl = "^${LAYERDIR}/"
BBFILE_PRIORITY_meta-supermicro-x10srl = "10"

LAYERDEPENDS_meta-supermicro-x10srl = "core openembedded-layer phosphor-layer"
LAYERSERIES_COMPAT_meta-supermicro-x10srl = "kirkstone langdale mickledore nanbield scarthgap"
```

## meta-supermicro-x10srl/conf/machine/x10srl-image.inc
```bitbake
IMAGE_INSTALL:append = " \
    x10srl-config \
    x10srl-led-manager \
    phosphor-pid-control \
    x86-power-control \
    ipmitool \
    ethtool \
    i2c-tools \
    lmsensors-sensors \
    memtester \
    stress-ng \
    "

# 启用额外功能
EXTRA_IMAGE_FEATURES += "ssh-server-openssh"

# U-Boot 环境变量
UBOOT_ENV_SUFFIX = "bin"
```

## openbmc-x10srl/meta-supermicro-x10srl/conf/layer.conf
```bitbake
# Layer configuration for Supermicro X10SRL
BBPATH =. "${LAYERDIR}:"
BBFILES += "${LAYERDIR}/recipes-*/*/*.bb \
            ${LAYERDIR}/recipes-*/*/*.bbappend"

BBFILE_COLLECTIONS += "supermicro-x10srl"
BBFILE_PATTERN_supermicro-x10srl = "^${LAYERDIR}/"
BBFILE_PRIORITY_supermicro-x10srl = "10"
LAYERSERIES_COMPAT_supermicro-x10srl = "langdale mickledore nanbield scarthgap"
LAYERDEPENDS_supermicro-x10srl = "core openembedded-layer networking-layer meta-aspeed"
```

## openbmc-x10srl/meta-supermicro-x10srl/conf/machine/x10srl.conf
```bitbake
KMACHINE = "aspeed"
KERNEL_DEVICETREE = "aspeed/aspeed-bmc-supermicro-x10srl.dts"

require conf/machine/include/ast2400.inc
require conf/machine/include/obmc-bsp-common.inc

UBOOT_MACHINE = "ast_g4_ncsi_config"
UBOOT_DEVICETREE = "ast2400-supermicro-x10srl"

FLASH_SIZE = "32768"

OBMC_MACHINE_FEATURES += "\
    obmc-phosphor-fan-mgmt \
    obmc-phosphor-chassis-mgmt \
    obmc-phosphor-flash-mgmt \
    obmc-host-ipmi \
    obmc-host-state-mgmt \
    obmc-chassis-state-mgmt \
    obmc-bmc-state-mgmt \
    "

VIRTUAL-RUNTIME_skeleton_workbook = "${MACHINE}-config"
PREFERRED_PROVIDER_virtual/obmc-chassis-mgmt = "packagegroup-supermicro-apps"
PREFERRED_PROVIDER_virtual/obmc-fan-mgmt = "packagegroup-supermicro-apps"
PREFERRED_PROVIDER_virtual/obmc-flash-mgmt = "packagegroup-supermicro-apps"
PREFERRED_PROVIDER_virtual/obmc-system-mgmt = "packagegroup-supermicro-apps"
PREFERRED_PROVIDER_virtual/obmc-host-ipmi-hw = "phosphor-ipmi-kcs"

OVERRIDES .= ":supermicro:x10srl"
```
